//*********************************************************** Explanation ***************************************************************//
/*
Last Update : 13960302
*/
//************************************************************* Warning *****************************************************************//
/*
none
*/
//************************************************************* Wizard ******************************************************************//
/*
none
*/
//************************************************************ defineds ******************************************************************//
/*
none
*/
//************************************************************ includes ******************************************************************//
#include "power.h"
//************************************************************ variables *****************************************************************//
/*
none
*/
//************************************************************* opjects ******************************************************************//
/*
none
*/
//************************************************************ functions *****************************************************************//
void __init_Power(void)
{
        GPIO_Output(SET);
}
//_-_-_-_-_-_-_-_-_-_-_-_-_-_-_-_-_-_-_-_-_-_-_-_-_-_-_-_-_-_-_-_-_-_-_-_-_-_-_-_-_-_-_-_-_-_-_-_-_-_-_-_-_-_-_-_-_-_-_-_-_-_-_-_-_-_-_-_-_-_
void POWER_Machine(void)
{
        static U8 State = POWER_STATE_HOLD;
        
        if(ADC_Arg() > POWER_TURNON_OFFSET)
        {
                State = POWER_STATE_TURNON;
        }
        else if(ADC_Arg() < POWER_TURNOFF_OFFSET)
        {
                State = POWER_STATE_TURNOFF;
        }
        else
        {
                 State = POWER_STATE_HOLD;
        }
        
        if(State == POWER_STATE_TURNON)
        {
                GPIO_Output(RESET);
        }
        else if(State == POWER_STATE_TURNOFF)
        {
                GPIO_Output(SET);
        }
}
//*************************************************************** tasks *******************************************************************//
/*
none
*/
//************************************************************** vectors ******************************************************************//
/*
none
*/
//****************************************************************************************************************************************//

