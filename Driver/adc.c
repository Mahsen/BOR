//*********************************************************** Explanation ***************************************************************//
/*
Last Update : 13960302
*/
//************************************************************* Warning *****************************************************************//
/*
none
*/
//************************************************************* Wizard ******************************************************************//
/*
none
*/
//************************************************************ defineds ******************************************************************//
/*
none
*/
//************************************************************ includes ******************************************************************//
#include "adc.h"
//************************************************************ variables *****************************************************************//
/*
none
*/
//************************************************************* opjects ******************************************************************//
/*
none
*/
//************************************************************ functions *****************************************************************//
void __init_ADC(void)
{
        ADC_PIN_DIRCTION = INPUT;

        ADC_PIN_ADMUX = 0x43; //Ref=1.1(v) //ADLAR=Off //ADC_Channel=3
        ADC_PIN_ADCSRA = 0x80; //ADEN=On //Div=2
        ADC_PIN_ADCSRB = 0x00; //Free Running mode
        ADC_PIN_DIDR = 0x08; //Enable D3
}
//_-_-_-_-_-_-_-_-_-_-_-_-_-_-_-_-_-_-_-_-_-_-_-_-_-_-_-_-_-_-_-_-_-_-_-_-_-_-_-_-_-_-_-_-_-_-_-_-_-_-_-_-_-_-_-_-_-_-_-_-_-_-_-_-_-_-_-_-_-_
void __uninit_ADC(void)
{
        DDRB_Bit3 = OUTPUT;
        PORTB_Bit3 = RESET;
        
        ADC_PIN_ADMUX = 0x00; 
        ADC_PIN_ADCSRA = 0x00; 
        ADC_PIN_ADCSRB = 0x00; 
        ADC_PIN_DIDR = 0x00;
}
//_-_-_-_-_-_-_-_-_-_-_-_-_-_-_-_-_-_-_-_-_-_-_-_-_-_-_-_-_-_-_-_-_-_-_-_-_-_-_-_-_-_-_-_-_-_-_-_-_-_-_-_-_-_-_-_-_-_-_-_-_-_-_-_-_-_-_-_-_-_
U16 ADC_Read(void)
{
        ADC_PIN_ADCSRA |= (SET << 6);
        for(U16 Time=RESET; Time<60000; Time++)
        {
                if(((ADC_PIN_ADCSRA >> 6) & 0x01) != SET)
                {
                        return (ADC&0x3FF);     
                }
        }
        
	return RESET;
}  
//_-_-_-_-_-_-_-_-_-_-_-_-_-_-_-_-_-_-_-_-_-_-_-_-_-_-_-_-_-_-_-_-_-_-_-_-_-_-_-_-_-_-_-_-_-_-_-_-_-_-_-_-_-_-_-_-_-_-_-_-_-_-_-_-_-_-_-_-_-_
U16 ADC_Arg(void)
{
        long adcavg;
	int adcnum;
	
	for(adcnum=RESET,adcavg=RESET; adcnum<100; adcnum++)
	{
		adcavg += ADC_Read();
	}
        
	return (adcavg/adcnum);
}  
//*************************************************************** tasks *******************************************************************//
/*
none
*/
//************************************************************** vectors ******************************************************************//
/*
none
*/
//****************************************************************************************************************************************//

